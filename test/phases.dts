// SPDX-License-Identifier: BSD-2-Clause
// Copyright 2022 Google LLC

// An attempt to provide a device tree to validate the phase properties

// dt-mk-schema -j test/schemas/ > processed-schema.json
// dtc -O dtb -o test.dtb test/phases.dts && tools/dt-validate -s processed-schema.json test.dtb


/dts-v1/;

/ {
	model = "none";
	compatible = "foo";

	#address-cells = <1>;
	#size-cells = <1>;

	some-device {
		compatible = "vendor,soc1-ip";
		phase-pre-sram;
	};
};
